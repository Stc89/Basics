/******************************************
	作者：神秘藏宝室
	店铺：ILoveMCU.taobao.com
******************************************/
#include	"config.h"
#include	"delay.h"

/*************	功能说明	**************

本程序演示LED闪烁  


******************************************/

/*************	本地常量声明	**************/


/*************	本地变量声明	**************/


/*************	本地函数声明	**************/



/*************  外部函数和变量声明 *****************/



/******************** IO配置函数 **************************/
void	GPIO_config(void)
{
	P1M0 = 0x00; 		//设置双向输入,P1.0和P1.1为输入高阻
	P1M1 = 0x03;

	P3M0 = 0x00;
	P3M1 = 0x00;




}

/******************** 主函数 **************************/
void main(void)
{
	GPIO_config();
	
	while(1)
	{
//		RELAY1 = 0;
//		RELAY2 = 1;
//		delay_ms(250);
//		delay_ms(250);
//		delay_ms(250);
//		delay_ms(250);
//		RELAY1 = 1;
//		RELAY2 = 0;
//		delay_ms(250);
//		delay_ms(250);
//		delay_ms(250);
//		delay_ms(250);

		if(SENSOR1 == 0)
		{
			RELAY1 = RELAY_OFF;
		}
		else
		{
			RELAY1 = RELAY_ON;
		}

		if(SENSOR2 == 0)
		{
			RELAY2 = RELAY_OFF;
		}
		else
		{
			RELAY2 = RELAY_ON;
		}
	
	}
}




